## app/west.yml
```yaml
manifest:
  self:
    path: app

  remotes:
    - name: ncs
      url-base: git@github.com:nrfconnect

  projects:
    - name: sdk-nrf
      remote: ncs
      path: nrf
      revision: v3.1.1
      import: true
```
